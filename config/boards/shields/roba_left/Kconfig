## config/boards/shields/roba_left/Kconfig
```kconfig
# roba_left/Kconfig
config SHIELD_ROBA_LEFT
    bool "roBa left"
    select ZMK_KEYMAP
```

## config/boards/shields/roba_right/Kconfig
```kconfig
# roba_right/Kconfig
config SHIELD_ROBA_RIGHT
    bool "roBa right"
    select ZMK_KEYMAP
```
