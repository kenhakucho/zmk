&kscan0 {
    col-gpios = <&gpio0 29 GPIO_ACTIVE_HIGH>,
                <&gpio0 28 GPIO_ACTIVE_HIGH>,
                <&gpio0 27 GPIO_ACTIVE_HIGH>;
    row-gpios = <&gpio0 26 GPIO_ACTIVE_HIGH>,
                <&gpio0 2 GPIO_ACTIVE_HIGH>,
                <&gpio1 15 GPIO_ACTIVE_HIGH>;
};