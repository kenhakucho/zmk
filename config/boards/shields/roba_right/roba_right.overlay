&kscan0 {
    col-gpios = <&gpio0 6 GPIO_ACTIVE_HIGH>,
                <&gpio0 8 GPIO_ACTIVE_HIGH>,
                <&gpio0 17 GPIO_ACTIVE_HIGH>;
    row-gpios = <&gpio1 1 GPIO_ACTIVE_HIGH>,
                <&gpio1 3 GPIO_ACTIVE_HIGH>,
                <&gpio1 5 GPIO_ACTIVE_HIGH>;
};